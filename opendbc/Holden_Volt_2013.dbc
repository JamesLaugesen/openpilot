VERSION ""

NS_ :

BS_:

BU_: XXX

BO_ 451 Accelerator_2: 8 XXX

BO_ 417 Accelerator_1: 8 XXX

BO_ 1001 Speed: 8 XXX
 SG_ Speed_KPH : 7|16@0+ (0.015625,0) [0|65535] "KPH" XXX

BO_ 518 Battery_SOC: 8 XXX

BO_ 309 Drive_Position: 8 XXX

BO_ 495 Engine_RPM: 8 XXX

BO_ 501 Shift_Position: 8 XXX

BO_ 995 Battery_kWh: 8 XXX

BO_ 1217 Outside_Temperature: 8 XXX
 SG_ Outside_Temperature_C : 32|8@1+ (0.5,-40) [0|255] "C" XXX

BO_ 1300 VIN_Part_1: 8 XXX

BO_ 1249 VIN_Part_2: 8 XXX

BO_ 241 NEW_MSG_1: 8 XXX

BO_ 304 NEW_MSG_2: 8 XXX

BO_ 193 NEW_MSG_3: 8 XXX
 SG_ NEW_SIGNAL_1 : 7|8@0+ (1,0) [0|255] "" XXX

BO_ 288 Odometer: 8 XXX
